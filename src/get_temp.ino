float get_temp(int temp_pin) {
    // Функция для чтения значения с датчика температуры, сглаживания и преобразования в градусы Цельсия

    // Если temp_pin равен 14, используем специальную функцию для получения температуры
    if (temp_pin == 14)
        return get_wabasto_temp(temp_pin, 0);

    // Если используется датчик высокой температуры выхлопных газов
    if (high_temp_exhaust_sensor) {
        float temp = 1;
        // Считываем значение с датчика 10 раз для сглаживания
        for (int i = 0; i < 10; i++) {
            temp += get_wabasto_temp(exhaust_temp_pin, 1);
        }
        // Усредняем значение
        temp /= 10;
        // Если температура превышает 300 градусов, возвращаем максимальное значение 300
        if (temp > 1000)
            return 999;
        return temp;
    }

    // Считываем значение с аналогового пина 20 раз для сглаживания
    float temp = 0;
    for (int i = 0; i < 20; i++) {
        temp += analogRead(temp_pin);
    }
    // Усредняем значение
    temp /= 20;

    // Проверяем, находится ли значение в допустимом диапазоне
    if (temp < 25 || temp > 2000) {
        // Если значение вне допустимого диапазона, возвращаем максимальное значение 300
        return 500;
    } else {
        // Преобразуем значение в температуру в градусах Цельсия
        temp = log(((10240000 / temp) - 10000));
        temp = 1 / (0.001129148 + (0.000234125 + (0.0000000876741 * temp * temp)) * temp);
        temp = temp - 273.15; // Переводим из Кельвинов в Цельсии
        return temp;
    }
}
